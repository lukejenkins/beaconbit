## main/Kconfig.projbuild
```kconfig
menu "Example Configuration"

    config ESP_WIFI_SSID
        string "WiFi SSID"
        default "myssid"
        help
            SSID (network name) for the example to connect to.

    config ESP_WIFI_PASSWORD
        string "WiFi Password"
        default "mypassword"
        help
            WiFi password (WPA or WPA2) for the example to use.
    config ESP_WIFI_CHANNEL
        int "WiFi Channel"
        range 1 11
        default 1
        help
            WiFi channel (network channel) for the example to use.

    config ESP_MAX_STA_CONN
        int "Maximal STA connections"
        default 4
        help
            Max number of the STA connects to AP.

    config ESP_GTK_REKEYING_ENABLE
        bool "Enable GTK Rekeying"
        default y
        help
            Flag to enable GTK rekeying.

    config ESP_GTK_REKEY_INTERVAL
        int "GTK rekey interval"
        depends on ESP_GTK_REKEYING_ENABLE
        range 60 65535
        default 600
        help
            GTK rekeying interval in seconds.

    config BEACONBIT_IPERF_SERVER_ENABLE
        bool "Enable iPerf Server"
        default y
        help
            Enable built-in iPerf server for network performance testing.
            When enabled, the iPerf server will start automatically on boot.

    config BEACONBIT_IPERF_SERVER_PORT
        int "iPerf Server Port"
        depends on BEACONBIT_IPERF_SERVER_ENABLE
        range 1024 65535
        default 5001
        help
            Port number for the iPerf server to listen on.
            Default is 5001 (standard iPerf port).
endmenu
```
